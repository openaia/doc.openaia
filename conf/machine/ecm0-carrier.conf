## conf/machine/rock64.conf
```bitbake
# Copyright (C) 2021 Blade SAS
# Released under the MIT license (see COPYING.MIT for the terms)

#@TYPE: Machine
#@NAME: Rock64
#@DESCRIPTION: Rock64 RK3328 board from Pine64

require include/rk3328.inc

MACHINE_FEATURES += "usbhost serial"

UBOOT_MACHINE = "rock64-rk3328_defconfig"
KERNEL_DEVICETREE = "rockchip/rk3328-rock64.dtb"

# set to mmcblk0 for booting from optional eMMC
RK_BOOT_DEVICE ?= "mmcblk1"

KBUILD_DEFCONFIG = "defconfig"
```

## wic/rk3399-boot.wks
```
# Copyright (C) 2020 Garmin Ltd. or its subsidiaries
# Released under the MIT license (see COPYING.MIT for the terms)
#
# Disk layout
# Note that the reference documentation refers to 512 byte disk sectors, but
# wic uses 1KB blocks
#
#   Partition   Start Sector    Number of Sectors
#   loader1     64              8000
#   reserved1   8064            128
#   reserved2   8192            8192
#   loader2     16384           8192
#   atf         24576           8192
#   boot        32768           229376
#   root        262144          -           (suggested)
#

part loader1    --offset 32     --fixed-size 4000K            --ondisk ${RK_BOOT_DEVICE} --source rawcopy --sourceparams="file=idbloader.img"
part reserved1  --offset 4032   --fixed-size 64K              --ondisk ${RK_BOOT_DEVICE}
part reserved2  --offset 4096   --fixed-size 4096K            --ondisk ${RK_BOOT_DEVICE}
part loader2    --offset 8192   --fixed-size 4096K            --ondisk ${RK_BOOT_DEVICE} --source rawcopy --sourceparams="file=u-boot.itb"
part atf        --offset 12288  --fixed-size 4096K            --ondisk ${RK_BOOT_DEVICE}
part /boot      --offset 16384  --size       114688K --active --ondisk ${RK_BOOT_DEVICE} --source bootimg-partition --fstype=vfat --label boot --sourceparams="loader=u-boot"
```

## wic/rock-pi-4.wks
```
# Copyright (C) 2020 Garmin Ltd. or its subsidiaries
# Released under the MIT license (see COPYING.MIT for the terms)

include rk3399-boot.wks
part / --align 131072 --source rootfs --fstype=ext4 --label root

bootloader --ptable gpt --append="console=tty1 console=ttyS2,1500000n8 rw root=/dev/mmcblk1p7 rootfstype=ext4 init=/sbin/init"
```

## wic/rock-pi-e.wks
```
include rk3328-boot.wks
part / --ondisk ${RK_BOOT_DEVICE} --source rootfs --fstype=ext4 --label root

bootloader --ptable gpt --append="console=tty1 console=${RK_CONSOLE_DEVICE},${RK_CONSOLE_BAUD}n8 rw root=/dev/${RK_BOOT_DEVICE}p7 rootfstype=ext4 init=/sbin/init"
```

## wic/tinker-board.wks
```
# Copyright (C) 2019 Garmin Ltd. or its subsidiaries
# Released under the MIT license (see COPYING.MIT for the terms)

include rk3288-boot.wks

part / --ondisk ${RK_BOOT_DEVICE} --source rootfs --fstype=ext4 --label root

bootloader --ptable gpt --append="console=tty1 console=${RK_CONSOLE_DEVICE},${RK_CONSOLE_BAUD}n8 rw root=/dev/${RK_BOOT_DEVICE}p7 rootfstype=ext4 init=/sbin/init"
```

## wic/vyasa-rk3288.wks
```
# Copyright (C) 2019 Garmin Ltd. or its subsidiaries
# Released under the MIT license (see COPYING.MIT for the terms)

include rk3288-boot.wks
part / --align 131072 --source rootfs --fstype=ext4 --label root

bootloader --ptable gpt --append="console=tty1 console=ttyS2,115200n8 rw root=/dev/mmcblk2p7 rootfstype=ext4 init=/sbin/init"
```
