## conf/machine/ecm0-carrier.conf
```bitbake
# Copyright (C) 2022 Edgeble AI Technologies Pvt. Ltd.
# Released under the MIT license (see COPYING.MIT for the terms)

#@TYPE: Machine
#@NAME: Edge Compute Module 0 Carrier
#@DESCRIPTION: Edgeble AI Edge Compute Module 0 Carrier Board is based on Rockchip RV1126 Processor.

require conf/machine/include/edge-compute-module-0.inc

# kernel
PREFERRED_PROVIDER_virtual/kernel = "linux-next"
PREFERRED_VERSION_linux-next ?= "5.19-%"

# kernel dtb
KERNEL_DEVICETREE = "rv1126-edgeble-ecm0-carrier.dtb"

# kernel defconfig
KBUILD_DEFCONFIG ?= "multi_v7_defconfig"

# u-boot
PREFERRED_PROVIDER_virtual/bootloader = "u-boot"
PREFERRED_VERSION_u-boot ?= "2022.10-%"

# u-boot defconfig
UBOOT_MACHINE = "ecm0-carrier-rv1126_defconfig"

# xz
IMAGE_FSTYPES += "wic.xz"
```

## conf/machine/include/edge-compute-module-0.inc
```bitbake
# Copyright (C) 2022 Edgeble AI Technologies Pvt. Ltd.
# Released under the MIT license (see COPYING.MIT for the terms)

# Add a common override for Edge Compute Module 0
MACHINEOVERRIDES =. "edge-compute-module-0:"

require conf/machine/include/rv1126.inc
require conf/machine/include/rockchip-wic.inc

# Remove unnecessary firmware
ROOTFS_POSTPROCESS_COMMAND:append = " do_post_rootfs;"
do_post_rootfs() {
	rm -rf ${IMAGE_ROOTFS}/lib/firmware/ath10k/QCA4019
	rm -rf ${IMAGE_ROOTFS}/lib/firmware/ath10k/QCA6174
	rm -rf ${IMAGE_ROOTFS}/lib/firmware/ath10k/QCA9887
	rm -rf ${IMAGE_ROOTFS}/lib/firmware/ath10k/QCA9888
	rm -rf ${IMAGE_ROOTFS}/lib/firmware/ath10k/QCA988X
	rm -rf ${IMAGE_ROOTFS}/lib/firmware/ath10k/QCA9984
	rm -rf ${IMAGE_ROOTFS}/lib/firmware/ath10k/QCA99X0
	rm -rf ${IMAGE_ROOTFS}/lib/firmware/ath10k/WCN3990
	rm -rf ${IMAGE_ROOTFS}/lib/firmware/ath10k/QCA9984
	rm ${IMAGE_ROOTFS}/lib/firmware/qca/crbtfw21.tlv
	rm ${IMAGE_ROOTFS}/lib/firmware/qca/crbtfw32.tlv
	rm ${IMAGE_ROOTFS}/lib/firmware/qca/crnv21.bin
	rm ${IMAGE_ROOTFS}/lib/firmware/qca/crnv32.bin
	rm ${IMAGE_ROOTFS}/lib/firmware/qca/crnv32u.bin
	rm ${IMAGE_ROOTFS}/lib/firmware/qca/htbtfw20.tlv
	rm ${IMAGE_ROOTFS}/lib/firmware/qca/htnv20.bin
	rm ${IMAGE_ROOTFS}/lib/firmware/qca/msbtfw11.mbn
	rm ${IMAGE_ROOTFS}/lib/firmware/qca/msbtfw11.tlv
	rm ${IMAGE_ROOTFS}/lib/firmware/qca/msnv11.bin
	rm ${IMAGE_ROOTFS}/lib/firmware/qca/nvm_00130300.bin
	rm ${IMAGE_ROOTFS}/lib/firmware/qca/nvm_00130302.bin
	rm ${IMAGE_ROOTFS}/lib/firmware/qca/nvm_00440302.bin
	rm ${IMAGE_ROOTFS}/lib/firmware/qca/nvm_00440302_eu.bin
	rm ${IMAGE_ROOTFS}/lib/firmware/qca/nvm_00440302_i2s_eu.bin
	rm ${IMAGE_ROOTFS}/lib/firmware/qca/nvm_usb_00000200.bin
	rm ${IMAGE_ROOTFS}/lib/firmware/qca/nvm_usb_00000201.bin
	rm ${IMAGE_ROOTFS}/lib/firmware/qca/nvm_usb_00000300.bin
	rm ${IMAGE_ROOTFS}/lib/firmware/qca/nvm_usb_00000302.bin
	rm ${IMAGE_ROOTFS}/lib/firmware/qca/nvm_usb_00000302_eu.bin
	rm ${IMAGE_ROOTFS}/lib/firmware/qca/nvm_usb_00130200.bin
	rm ${IMAGE_ROOTFS}/lib/firmware/qca/nvm_usb_00130200_0104.bin
	rm ${IMAGE_ROOTFS}/lib/firmware/qca/nvm_usb_00130200_0105.bin
	rm ${IMAGE_ROOTFS}/lib/firmware/qca/nvm_usb_00130200_0106.bin
	rm ${IMAGE_ROOTFS}/lib/firmware/qca/nvm_usb_00130200_0107.bin
	rm ${IMAGE_ROOTFS}/lib/firmware/qca/nvm_usb_00130200_0109.bin
	rm ${IMAGE_ROOTFS}/lib/firmware/qca/nvm_usb_00130200_0110.bin
	rm ${IMAGE_ROOTFS}/lib/firmware/qca/nvm_usb_00130201.bin
	rm ${IMAGE_ROOTFS}/lib/firmware/qca/nvm_usb_00130201_010a.bin
	rm ${IMAGE_ROOTFS}/lib/firmware/qca/nvm_usb_00130201_010b.bin
	rm ${IMAGE_ROOTFS}/lib/firmware/qca/nvm_usb_00130201_0303.bin
	rm ${IMAGE_ROOTFS}/lib/firmware/qca/nvm_usb_00130201_gf.bin
	rm ${IMAGE_ROOTFS}/lib/firmware/qca/nvm_usb_00130201_gf_010a.bin
	rm ${IMAGE_ROOTFS}/lib/firmware/qca/nvm_usb_00130201_gf_010b.bin
	rm ${IMAGE_ROOTFS}/lib/firmware/qca/nvm_usb_00130201_gf_0303.bin
	rm ${IMAGE_ROOTFS}/lib/firmware/qca/rampatch_00130300.bin
	rm ${IMAGE_ROOTFS}/lib/firmware/qca/rampatch_00130302.bin
	rm ${IMAGE_ROOTFS}/lib/firmware/qca/rampatch_00440302.bin
	rm ${IMAGE_ROOTFS}/lib/firmware/qca/rampatch_usb_00000200.bin
	rm ${IMAGE_ROOTFS}/lib/firmware/qca/rampatch_usb_00000201.bin
	rm ${IMAGE_ROOTFS}/lib/firmware/qca/rampatch_usb_00000300.bin
	rm ${IMAGE_ROOTFS}/lib/firmware/qca/rampatch_usb_00000302.bin
	rm ${IMAGE_ROOTFS}/lib/firmware/qca/rampatch_usb_00130200.bin
	rm ${IMAGE_ROOTFS}/lib/firmware/qca/rampatch_usb_00130201.bin
}
```

## conf/machine/include/nanopi-m4.inc
```bitbake
# Copyright (C) 2021 Blade SAS
# Common definitions for all NanoPi M4 RK3399 board variants

# add a common override for all nanopi-m4
MACHINEOVERRIDES =. "nanopi-m4:"

require conf/machine/include/rk3399.inc

MACHINE_FEATURES += "usbhost serial"

KERNEL_DEVICETREE = "rockchip/rk3399-nanopi-m4.dtb"
```

## conf/machine/include/rk3066.inc
```bitbake
# Copyright (C) 2014 NEO-Technologies
# Released under the MIT license (see COPYING.MIT for the terms)

SOC_FAMILY = "rk3066"

require conf/machine/include/tune-cortexa9.inc
require conf/machine/include/soc-family.inc
require conf/machine/include/rockchip-defaults.inc

SERIAL_CONSOLES = "115200;ttyS2"

KBUILD_DEFCONFIG = "multi_v7_defconfig"
KERNEL_IMAGETYPE = "zImage"
```

## conf/machine/include/rk3288.inc
```bitbake
# Copyright (C) 2015 Romain Perier
# Released under the MIT license (see COPYING.MIT for the terms)

SOC_FAMILY = "rk3288"

require conf/machine/include/arm/armv7a/tune-cortexa17.inc
require conf/machine/include/soc-family.inc
require conf/machine/include/rockchip-defaults.inc

SERIAL_CONSOLES = "115200;ttyS2"

KBUILD_DEFCONFIG ?= "multi_v7_defconfig"
KERNEL_IMAGETYPE = "zImage"

PREFERRED_PROVIDER:virtual/bootloader ?= "u-boot"
UBOOT_SUFFIX ?= "bin"
```

## conf/machine/include/rk3328.inc
```bitbake
# Copyright (C) 2021 Blade SAS
# Released under the MIT license (see COPYING.MIT for the terms)

SOC_FAMILY = "rk3328"

DEFAULTTUNE ?= "cortexa53-crypto"

require conf/machine/include/soc-family.inc
require conf/machine/include/tune-cortexa53.inc
require conf/machine/include/rockchip-defaults.inc

KBUILD_DEFCONFIG ?= "defconfig"
KERNEL_CLASSES = "kernel-fitimage"
KERNEL_IMAGETYPE = "fitImage"

TFA_PLATFORM = "rk3328"
TFA_BUILD_TARGET = "bl31"

UBOOT_SUFFIX ?= "itb"
UBOOT_ENTRYPOINT ?= "0x06000000"

SERIAL_CONSOLES = "1500000;ttyS2"

PREFERRED_PROVIDER_virtual/bootloader ?= "u-boot"
SPL_BINARY ?= "idbloader.img"
```

## conf/machine/include/rk3399.inc
```bitbake
# Copyright (C) 2020 Garmin Ltd. or its subsidaries
# Released under the MIT license (see COPYING.MIT for the terms)

SOC_FAMILY = "rk3399"

DEFAULTTUNE ?= "cortexa72-cortexa53-crypto"

require conf/machine/include/soc-family.inc
require conf/machine/include/tune-cortexa72-cortexa53.inc
require conf/machine/include/rockchip-defaults.inc
require conf/machine/include/rockchip-wic.inc

KBUILD_DEFCONFIG ?= "defconfig"
KERNEL_CLASSES = "kernel-fitimage"
KERNEL_IMAGETYPE = "fitImage"

TFA_PLATFORM = "rk3399"
TFA_BUILD_TARGET = "bl31"

UBOOT_SUFFIX ?= "itb"
UBOOT_ENTRYPOINT ?= "0x06000000"

PREFERRED_PROVIDER:virtual/bootloader ?= "u-boot"
```

## conf/machine/include/rock-pi-4.inc
```bitbake
# Add a common override for all Rock Pi 4 machines
MACHINEOVERRIDES =. "rock-pi-4:"

require conf/machine/include/rk3399.inc

RK_BOOT_DEVICE = "mmcblk1"

MACHINE_EXTRA_RRECOMMENDS += "kernel-modules"
```

## conf/machine/include/rockchip-defaults.inc
```bitbake
# meta-rockchip default settings

# kernel
PREFERRED_PROVIDER_virtual/kernel ?= "linux-yocto"
KCONFIG_MODE ?= "alldefconfig"

# xserver
PREFERRED_PROVIDER_virtual/xserver = "xserver-xorg"
XSERVER = " \
	xserver-xorg \
	xserver-xorg-utils \
	xserver-xorg-xvfb \
	xserver-xorg-extension-glx \
	xserver-xorg-module-libwfb \
	xserver-xorg-module-exa \
	xf86-video-modesetting \
	xf86-input-evdev \
	xf86-input-mouse \
	xf86-input-keyboard \
	"

# misc
SERIAL_CONSOLES ?= "1500000;ttyS2"
```

## conf/machine/include/rv1126.inc
```bitbake
# Copyright (C) 2022 Edgeble AI Technologies Pvt. Ltd.
# Released under the MIT license (see COPYING.MIT for the terms)

SOC_FAMILY = "rv1126"

require conf/machine/include/arm/armv7a/tune-cortexa7.inc
require conf/machine/include/soc-family.inc
require conf/machine/include/rockchip-defaults.inc

SERIAL_CONSOLES = "1500000;ttyS2"

KBUILD_DEFCONFIG ?= "multi_v7_defconfig"
KERNEL_IMAGETYPE = "zImage"

UBOOT_SUFFIX ?= "img"
```

## conf/machine/include/tinker.inc
```bitbake
require conf/machine/include/rk3288.inc
require conf/machine/include/rockchip-wic.inc
```

## conf/machine/nanopi-m4-2gb.conf
```bitbake
# Copyright (C) 2021 Blade SAS

#@TYPE: Machine
#@NAME: NanoPi M4
#@DESCRIPTION: NanoPi M4 RK3399 board from FriendlyElec, 2GB variant

require include/nanopi-m4.inc
UBOOT_MACHINE = "nanopi-m4-2gb-rk3399_defconfig"
```

## conf/machine/nanopi-m4.conf
```bitbake
# Copyright (C) 2021 Blade SAS

#@TYPE: Machine
#@NAME: NanoPi M4
#@DESCRIPTION: NanoPi M4 RK3399 board from FriendlyElec, 4GB variant

require include/nanopi-m4.inc
UBOOT_MACHINE = "nanopi-m4-rk3399_defconfig"
```

## conf/machine/neu2-io.conf
```bitbake
# Copyright (C) 2022 Edgeble AI Technologies Pvt. Ltd.
# Released under the MIT license (see COPYING.MIT for the terms)

#@TYPE: Machine
#@NAME: Edgeble Neural Compute Module 2
#@DESCRIPTION: Edgeble Neural Compute Module 2 Carrier Board is based on Rockchip RV1126 Processor.

require conf/machine/include/edge-compute-module-0.inc

# kernel
PREFERRED_PROVIDER_virtual/kernel = "linux-next"
PREFERRED_VERSION_linux-next ?= "6%"

# kernel dtb
KERNEL_DEVICETREE = "rv1126-edgeble-neu2-io.dtb"

KERNEL_VERSION_SANITY_SKIP="1"

# kernel defconfig
KBUILD_DEFCONFIG ?= "multi_v7_defconfig"

# u-boot
PREFERRED_PROVIDER_virtual/bootloader = "u-boot"
PREFERRED_VERSION_u-boot ?= "2022.10-%"

# u-boot defconfig
UBOOT_MACHINE = "neu2-io-rv1126_defconfig"

# xz
IMAGE_FSTYPES += "wic.xz"

MACHINE_FEATURES:append  = "ext2 ext3 usbhost usbgadget"
DISTRO_FEATURES:append = "systemd bluetooth wifi"

# Enable extra firmware for wifi and bluetooth
MACHINE_ESSENTIAL_EXTRA_RRECOMMENDS += " \
    kernel-modules \
    packagegroup-ecm0 \
"
```

## conf/machine/neu2a-io.conf
```bitbake
# Copyright (C) 2022 Edgeble AI Technologies Pvt. Ltd.
# Released under the MIT license (see COPYING.MIT for the terms)

#@TYPE: Machine
#@NAME: Edgeble Neural Compute Module 2a
#@DESCRIPTION: Edgeble Neural Compute Module 2a

require conf/machine/include/edge-compute-module-0.inc

# console
SERIAL_CONSOLES = "115200;ttyFIQ0"

# kernel
PREFERRED_PROVIDER_virtual/kernel = "linux-kernel"
PREFERRED_VERSION_linux-kernel ?= "4.19%"
LINUX_VERSION = "4.19"
PREFERRED_VERSION_linux-libc-headers = "4.19"

# kernel dtb
KERNEL_DEVICETREE = "rv1126-edgeble-neu2-io.dtb"
LINUXLIBCVERSION = "4.19"

KERNEL_VERSION_SANITY_SKIP="1"

# kernel defconfig
KBUILD_DEFCONFIG = "rv1126_defconfig"

# u-boot
PREFERRED_PROVIDER_virtual/bootloader = "u-boot"
PREFERRED_VERSION_u-boot ?= "2022.10-%"

# u-boot defconfig
UBOOT_MACHINE = "neu2-io-rv1126_defconfig"

# xz
IMAGE_FSTYPES += "wic.xz"

MACHINE_FEATURES:append  = "ext2 ext3 usbhost usbgadget"
DISTRO_FEATURES:append = "systemd bluetooth wifi"

# Enable extra firmware for wifi and bluetooth
MACHINE_ESSENTIAL_EXTRA_RRECOMMENDS += " \
    kernel-modules \
    packagegroup-ecm0 \
"

IMAGE_INSTALL:append = " \
    canutils \
"
```

## conf/machine/neu2a-v2.conf
```bitbake
# Copyright (C) 2022 Edgeble AI Technologies Pvt. Ltd.
# Released under the MIT license (see COPYING.MIT for the terms)

#@TYPE: Machine
#@NAME: Edgeble Neural Compute Module 2
#@DESCRIPTION: Edgeble Neural Compute Module 2 Carrier Board is based on Rockchip RV1126 Processor.

require conf/machine/include/edge-compute-module-0.inc

# console
SERIAL_CONSOLES = "115200;ttyS2"

# kernel
PREFERRED_PROVIDER_virtual/kernel = "linux-next"
PREFERRED_VERSION_linux-next ?= "6.5%"

# kernel dtb
KERNEL_DEVICETREE = "\
   rockchip/rv1126-edgeble-neu2-io.dtb \
   rockchip/rv1126-edgeble-neu2-io-dsi.dtbo \
   rockchip/radxa-display-10hd.dtbo \
   rockchip/radxa-display-8hd.dtbo \
"

KERNEL_VERSION_SANITY_SKIP="1"

# kernel defconfig
KBUILD_DEFCONFIG ?= "multi_v7_defconfig"

# u-boot
PREFERRED_PROVIDER_virtual/bootloader = "u-boot-neu2a"
PREFERRED_VERSION_u-boot ?= "2022.10-%"

# u-boot defconfig
UBOOT_MACHINE = "neu2-io-rv1126_defconfig"

# xz
IMAGE_FSTYPES += "wic.xz"

MACHINE_FEATURES:append  = "ext2 ext3 usbhost usbgadget"
DISTRO_FEATURES:append = "systemd bluetooth wifi"

# Enable extra firmware for wifi and bluetooth
MACHINE_ESSENTIAL_EXTRA_RRECOMMENDS += " \
    kernel-modules \
    packagegroup-ecm0 \
"

IMAGE_INSTALL:append = " \
    alsa-utils \
    canutils \
    evtest \
    iperf3 \
    devmem2 \
"
```

## conf/machine/neu6b-v2-5.10.conf
```bitbake
# Copyright (C) 2023 Edgeble AI Technologies Pvt. Ltd.
# Released under the MIT license (see COPYING.MIT for the terms)

#@TYPE: Machine
#@NAME: Edgeble Neural Compute Module 6B
#@DESCRIPTION: Edgeble Neural Compute Module 6B

require conf/machine/include/rk3588.inc

SOC_FAMILY = "rk3588"

# console
SERIAL_CONSOLES = "1500000;ttyFIQ0"

# kernel
PREFERRED_PROVIDER_virtual/kernel = "linux-kernel-neu6b-v2"
PREFERRED_VERSION_linux-kernel = "5.10"
LINUX_VERSION = "5.10"
PREFERRED_VERSION_linux-libc-headers = "5.10"
KBUILD_DEFCONFIG = "rockchip_linux_defconfig"
KERNEL_DEVICETREE = " \
    rockchip/rk3588-edgeble-neu6a-io.dtb \
    rockchip/rk3588-edgeble-neu6a-io-cam.dtb \
    rockchip/rk3588-edgeble-neu6a-io-dp0.dtb \
    rockchip/rk3588-edgeble-neu6a-io-dp1.dtb \
    rockchip/rk3588-edgeble-neu6a-io-dsi0.dtb \
    rockchip/rk3588-edgeble-neu6a-io-dsi1.dtb \
    rockchip/rk3588-edgeble-neu6a-io-edp.dtb \
    rockchip/rk3588-edgeble-neu6a-io-edp0-hdmi-dsi0-dsi1.dtb \
    rockchip/rk3588-edgeble-neu6b-io.dtb \
    rockchip/rk3588-edgeble-neu6b-io-cam.dtb \
    rockchip/rk3588-edgeble-neu6b-io-dp0.dtb \
    rockchip/rk3588-edgeble-neu6b-io-dp1.dtb \
    rockchip/rk3588-edgeble-neu6b-io-dsi0.dtb \
    rockchip/rk3588-edgeble-neu6b-io-dsi1.dtb \
    rockchip/rk3588-edgeble-neu6b-io-edp.dtb \
    rockchip/rk3588-edgeble-neu6b-io-edp0-hdmi-dsi0-dsi1.dtb \
"
LINUXLIBCVERSION = "5.10"
KERNEL_VERSION_SANITY_SKIP="1"

# u-boot
PREFERRED_PROVIDER_virtual/bootloader = "u-boot-neu6b"
PREFERRED_VERSION_u-boot = "2023.10-%"
UBOOT_MACHINE = "neu6b-io-rk3588_defconfig"

# xz
IMAGE_FSTYPES += "wic.xz wic.bmap"

MACHINE_FEATURES:append  = "ext2 ext3 usbhost usbgadget bluetooth"
DISTRO_FEATURES:append = "systemd bluetooth wifi"

MACHINE_ESSENTIAL_EXTRA_RDEPENDS += " \
    linux-firmware-iwlwifi-8000c \
    linux-firmware-ibt-11-5 \
"

IMAGE_INSTALL:append = " \
    kernel-modules \
    i2c-tools \
    alsa-utils \
    canutils \
    evtest \
    iperf3 \
    minicom \
    ppp \
    usbutils \
    pciutils \
"
```

## conf/machine/rock-pi-4.conf
```bitbake
# Copyright (C) 2020 Garmin Ltd. or its subsidaries
# Released under the MIT license (see COPYING.MIT for the terms)

#@TYPE: Machine
#@NAME: Rock Pi 4 RK3399
#@DESCRIPTION: Rock Pi 4 is a Raspberry Pi 4 Alternative based on Rockchip RK3399 Processor.
#
# NOTE: This machine is for Kernels before 5.10. If you are using an newer kernel
# see rock-pi-4{a,b,c}.conf

require conf/machine/include/rock-pi-4.inc

KERNEL_DEVICETREE = "rockchip/rk3399-rock-pi-4.dtb"
UBOOT_MACHINE = "rock-pi-4-rk3399_defconfig"
```

## conf/machine/rock-pi-e.conf
```bitbake
#@TYPE: Machine
#@NAME: ROCK Pi E rk3328
#@DESCRIPTION: ROCK Pi E is a Rockchip RK3328-based SBC by Radxa. E is for Ethernets.
#https://wiki.radxa.com/RockpiE

require conf/machine/include/rk3328.inc

MACHINEOVERRIDES =. "rock-pi-e:"

PREFERRED_PROVIDER:virtual/kernel = "linux-yocto-dev"
KERNEL_DEVICETREE = "rockchip/rk3328-rock-pi-e.dtb"
MACHINE_EXTRA_RRECOMMENDS += "kernel-modules"

PREFERRED_PROVIDER:virtual/bootloader = "u-boot"
UBOOT_MACHINE = "rock-pi-e-rk3328_defconfig"
```
